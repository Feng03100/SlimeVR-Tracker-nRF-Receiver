## boards/foxapplication/foxpromicro_rfek_uf2/Kconfig.foxpromicro_rfek_uf2
```kconfig
# Copyright (c) 2024 Nordic Semiconductor ASA
# SPDX-License-Identifier: Apache-2.0

config BOARD_FOXPROMICRO_RFEK_UF2
	select SOC_NRF52840_QIAA

if BOARD_FOXPROMICRO_RFEK_UF2

config BOARD_SERIAL_BACKEND_CDC_ACM
	bool "USB CDC"
	default y

config BOARD_ENABLE_FEM
	bool "FEM enabled"
	default y
	select MPSL_FEM
	select MPSL_FEM_NRF21540_GPIO
	help
	  Enable front-end module (nRF21540).

endif # BOARD_FOXPROMICRO_RFEK_UF2
```

## boards/foxapplication/foxpromicro_rfek_uf2/foxpromicro_rfek_uf2_defconfig
```kconfig
# Copyright (c) 2024 Nordic Semiconductor ASA
# SPDX-License-Identifier: Apache-2.0

CONFIG_ARM_MPU=y
CONFIG_HW_STACK_PROTECTION=y
CONFIG_GPIO=y

CONFIG_USB_DEVICE_MANUFACTURER="FoxApplication"
CONFIG_USB_DEVICE_PRODUCT="FoxApplication FoxProMicro RFEK"

CONFIG_USE_SEGGER_RTT=y
CONFIG_RTT_CONSOLE=y
CONFIG_LOG_BACKEND_RTT=y

CONFIG_MPSL=y
CONFIG_MPSL_FEM=y
# Let DTS auto-select the nRF21540 GPIO implementation
# CONFIG_MPSL_FEM_NRF21540_GPIO=y

#generate for adafruit uf2 bootloader flashing
CONFIG_BUILD_OUTPUT_UF2=y
CONFIG_FLASH_LOAD_OFFSET=0x1000
```
